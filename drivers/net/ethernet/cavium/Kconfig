## drivers/net/ethernet/cavium/Kconfig
```kconfig
#
# Cavium ethernet device configuration
#

config NET_VENDOR_CAVIUM
	tristate "Cavium ethernet drivers"
	depends on PCI
	default y
	---help---
	  Select this option if you want enable Cavium network support.

	  If you have a Cavium SoC or network adapter, say Y.

if NET_VENDOR_CAVIUM

config LIQUIDIO
	tristate "Cavium LiquidIO support"
	depends on 64BIT
	select PTP_1588_CLOCK
	select FW_LOADER
	select LIBCRC32C
	---help---
	  This driver supports Cavium LiquidIO Intelligent Server Adapters
	  based on CN66XX and CN68XX chips.

	  To compile this driver as a module, choose M here: the module
	  will be called liquidio.  This is recommended.

endif # NET_VENDOR_CAVIUM
```
